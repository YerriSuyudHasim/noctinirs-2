## components/nn2_ad_wifi/Kconfig
```kconfig
menu "NoctiNIRS 2 Wi-Fi station"

    config NN2_WIFI_BACKOFF_FIRST_MS
        int "STA reconnect first backoff after the immediate retry (ms)"
        default 500
        range 1 1000
        help
            Delay before the second reconnect attempt. The first attempt
            after WIFI_EVENT_STA_DISCONNECTED is immediate (0 ms) and is
            posted to the station task. This value must be <= 1000 and
            < 3000 so that retry can occur inside the 3 s Wi-Fi-loss grace
            window. The grace timer itself is not implemented here.

    config NN2_WIFI_BACKOFF_MAX_MS
        int "STA reconnect backoff cap (ms)"
        default 8000
        range 1000 60000
        help
            Upper bound for the doubling reconnect delay. The sequence
            after the immediate retry is FIRST, 2*FIRST, ... up to this cap.

endmenu
```

## firmware/v4-idf61/main/Kconfig.projbuild
```kconfig
menu "V4 IDF 6.1 migration"
config NOCTI_V4_NN2_COMMUNICATION
    bool "Use NN2 SoftAP/UDP control with V4 acquisition runtime"
    default y
    help
        Reuses nn2ctl command/reply/session/lease handling. V4 console remains
        read-only except emergency STOP; old V4 network is not initialized.
        Native V4 optical frames are not relabelled as ACQ1.

config NOCTI_V4_MIGRATION_WIFI_PASSWORD
    string "Local bench SoftAP WPA2 password (8 to 63 characters)"
    depends on !NOCTI_V4_NN2_COMMUNICATION
    default ""
    help
        Set only in the ignored local sdkconfig. The historical embedded
        password is intentionally excluded. Empty leaves network unavailable;
        USB diagnostics and explicit-start behavior remain available.
endmenu
```

## main/Kconfig.projbuild
```kconfig
menu "NoctiNIRS 2 v0.1.0"

    choice NN2_PROFILE
        prompt "Firmware profile"
        default NN2_PROFILE_FAKE
        config NN2_PROFILE_COMMUNICATION
            bool "Communication Foundation / emitter reset held low"
            help
                SoftAP-only, NVS boot identity, USB diagnostics and UDP request/reply.
                LED/ADC commands are simulated; RESET_LED remains asserted.
                Use sdkconfig.communication for the required main task stack.
        config NN2_PROFILE_FAKE
            bool "Fake ADC / disabled emitter baseline"
        config NN2_PROFILE_ADS131_DIAGNOSTIC
            bool "ADS131 diagnostic / emitter energy unavailable fixture required"
    endchoice

    config NN2_UDP_PORT
        int "Communication Foundation UDP control port"
        range 1024 65535
        default 3333

    config NN2_LED_BRINGUP
        bool "Enable real LED-only bring-up commands (requires reviewed bench procedure)"
        depends on NN2_PROFILE_COMMUNICATION
        default n
        select GPIO_CTRL_FUNC_IN_IRAM
        select GPTIMER_ISR_CACHE_SAFE
        select GPTIMER_CTRL_FUNC_IN_IRAM
        select I2C_ISR_IRAM_SAFE
        help
            Real PCA9956B drive on explicit START, 20 optical slots, one channel
            at a time. Boot remains OFF. Default Fs=5 Hz and current=30 mA.
            No ADC/frames. Physical energization requires Owner authorization.

    config NN2_LED_SHORT_BENCH
        bool "Board-specific SHORT advisory engineering candidate (unqualified)"
        depends on NN2_LED_BRINGUP
        default n
        help
            Same assembled board only, Fs2..10Hz, twenty nominal 30 mA slots.
            Host-selected duration, repeat START after completed STOP/cleanup.
            No firmware duration ceiling; lease timeout and hard faults remain.
            Can mask a real short. Requires specialist review before activation.

    config NN2_LED_RUNTIME_I2C_HZ
        int "LED async runtime SCL (800kHz is an experimental board setting)"
        depends on NN2_LED_BRINGUP
        range 100000 800000
        default 400000
        help
            Boot/configuration uses synchronous100kHz. Only the exclusive LED
            scan owner uses this async runtime rate. ESP32-S3 documentation
            specifies400kHz maximum; the Owner-selected800kHz V4-style setting
            is experimental and is not an SDK/electrical qualification.

    config NN2_LED_SETTLE_US
        int "Settle wait between (disabled) LED on and (fake) sample (us)"
        range 0 1000
        default 100
        help
            Short bounded busy-wait (esp_rom_delay_us) in the sequencer task.
            Capped at 1 ms; any longer wait must become a blocking RTOS delay
            (pending Agent 05 / RTOS review, #12).

    config NN2_DEMO_CYCLES
        int "Number of acquisition cycles to run at boot"
        range 1 1000
        default 5

endmenu
```

## reference/v3/Kconfig.projbuild
```kconfig
menu "NoctiNIRSv3 validation profile"

choice NOCTI_V3_I2C_PROFILE
    prompt "PCA9956B I2C clock profile"
    default NOCTI_V3_I2C_PROFILE_400KHZ
    help
        Keep 400 kHz as the validation default. The 1 MHz profile is only for
        controlled comparison with logic-analyzer evidence and must not be
        promoted to the default based on a successful build alone.

    config NOCTI_V3_I2C_PROFILE_400KHZ
        bool "400 kHz (default validation profile)"

    config NOCTI_V3_I2C_PROFILE_1MHZ_EXPERIMENT
        bool "1 MHz (experimental; waveform and error-rate validation required)"
endchoice

endmenu
```
